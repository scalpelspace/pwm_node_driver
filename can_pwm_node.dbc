VERSION ""

NS_ :

BS_:

BU_:

BO_ 32 state: 1 Vector__XXX
 SG_ system_state : 0|8@1+ (1,0) [0|255] "" Vector__XXX

BO_ 64 command_servo_1: 2 Vector__XXX
 SG_ command_servo_1_pmw : 0|16@1+ (1,0) [500|2500] "us" Vector__XXX

BO_ 96 command_servo_2: 2 Vector__XXX
 SG_ command_servo_2_pmw : 0|16@1+ (1,0) [500|2500] "us" Vector__XXX

BO_ 128 command_servo_3: 2 Vector__XXX
 SG_ command_servo_3_pmw : 0|16@1+ (1,0) [500|2500] "us" Vector__XXX

BO_ 160 command_servo_4: 2 Vector__XXX
 SG_ command_servo_4_pmw : 0|16@1+ (1,0) [500|2500] "us" Vector__XXX

CM_ BO_ 32 "State machine info";
BA_DEF_  "BusType" STRING ;
BA_DEF_DEF_  "BusType" "CAN";
